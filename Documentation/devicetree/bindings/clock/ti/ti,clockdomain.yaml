## Documentation/devicetree/bindings/clock/ti/ti,clockdomain.yaml
```yaml
# SPDX-License-Identifier: (GPL-2.0-only OR BSD-2-Clause)
%YAML 1.2
---
$id: http://devicetree.org/schemas/clock/ti/ti,clockdomain.yaml#
$schema: http://devicetree.org/meta-schemas/core.yaml#

title: TI clock domain

maintainers:
  - Tero Kristo <kristo@kernel.org>
  - Sukrut Bellary <sbellary@baylibre.com>

description: |
  Every clock on TI SoC belongs to one clockdomain. For specific clocks, the
  parent clockdomain has to be controlled when the clock is enabled/disabled.
  This binding doesn't define a new clock binding type, it is used to group
  the existing clock nodes under hardware hierarchy.

properties:
  compatible:
    const: ti,clockdomain

  "#clock-cells":
    const: 0

  clocks:
    description:
      Clocks within this domain

  clock-output-names:
    description:
      From common clock binding
    minItems: 1

required:
  - compatible
  - clocks
  - "#clock-cells"

additionalProperties: false

examples:
  - |
    l3init_clkdm: l3init_clkdm {
        #clock-cells = <0>;
        compatible = "ti,clockdomain";
        clock-output-names = "l3init_clkdm";
        clocks = <&dpll_usb_ck>;
    };
```

## Documentation/devicetree/bindings/clock/ti/ti,fixed-factor-clock.yaml
```yaml
# SPDX-License-Identifier: (GPL-2.0-only OR BSD-2-Clause)
%YAML 1.2
---
$id: http://devicetree.org/schemas/clock/ti/ti,fixed-factor-clock.yaml#
$schema: http://devicetree.org/meta-schemas/core.yaml#

title: TI fixed factor rate clock sources

maintainers:
  - Tero Kristo <kristo@kernel.org>
  - Sukrut Bellary <sbellary@baylibre.com>

description: |
  This consists of a divider and a multiplier used to generate
  a fixed rate clock. This also uses the autoidle support from
  TI autoidle clock[1].

  [1] Documentation/devicetree/bindings/clock/ti/ti,autoidle.yaml

properties:
  compatible:
    const: ti,fixed-factor-clock

  "#clock-cells":
    const: 0

  ti,clock-div:
    $ref: /schemas/types.yaml#/definitions/uint32
    description: Fixed divider

  ti,clock-mult:
    $ref: /schemas/types.yaml#/definitions/uint32
    description: Fixed multiplier

  clocks:
    description:
      Link to phandle of parent clock.

  clock-output-names:
    description:
      From common clock binding

  ti,autoidle-shift:
    $ref: /schemas/types.yaml#/definitions/uint32
    description:
      bit shift of the autoidle enable bit for the clock, see [1]

  reg:
    maxItems: 1
    description:
      offset for the autoidle register of this clock, see [1]

  ti,invert-autoidle-bit:
    description:
      autoidle is enabled by setting the bit to 0, see [1]
    type: boolean

  ti,set-rate-parent:
    description:
      Propagate to parent clock
    type: boolean

required:
  - compatible
  - clocks
  - "#clock-cells"
  - ti,clock-mult
  - ti,clock-div

additionalProperties: false

examples:
  - |
    cm2_clocks: clocks {
        #address-cells = <1>;
        #size-cells = <0>;

        dpll_usb_clkdcoldo_ck: clock@1b4 {
            compatible = "ti,fixed-factor-clock";
            reg = <0x01b4>;
            clocks = <&dpll_usb_ck>;
            #clock-cells = <0>;
            ti,clock-mult = <1>;
            ti,clock-div = <1>;
            ti,autoidle-shift = <8>;
            ti,invert-autoidle-bit;
        };
    };
```
